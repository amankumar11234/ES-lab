	AREA RESET, DATA, READONLY
	EXPORT __Vectors
__Vectors
	DCD 0x10001000
	DCD Reset_Handler
	
	AREA mycode, CODE, READONLY
	ENTRY
	EXPORT Reset_Handler
Reset_Handler
	LDR R0,=VALUE1
	LDR R1,=VALUE2
	LDR R5,=result
	
	MOV R2,#4
BACK	LDR R3, [R0], #4
		LDR R4, [R1], #4
		ADCS R3, R4
		STR R3, [R5], #4
		
		SUB R2, #1
		TEQ R2,#0
		BNE BACK
	
	;LDR R6,#0
	ADC R6,#0
	STR R6, [R5]
STOP B STOP
VALUE1 DCD 0xFFFFFFFF, 0xFFFFFFFF, 0xFFFFFFFF, 0xFFFFFFFF
VALUE2 DCD 0xFFFFFFFF, 0xFFFFFFFF, 0xFFFFFFFF, 0xFFFFFFFF
;VALUE1 DCD 0x11111111, 0x11111112, 0x11111113, 0x11111114   ;ROM
;VALUE2 DCD 0x11111111, 0x21111112, 0x31111113, 0x41111114
	AREA mydata, DATA, READWRITE
result DCD 0, 0, 0, 0 ;ram
	END